## package/gobject-introspection/Config.in
```kconfig
config BR2_PACKAGE_GOBJECT_INTROSPECTION
	bool "gobject-introspection"
	help
	  gobject-introspection

	  https://wiki.gnome.org/action/show/Projects/GObjectIntrospection
```

## package/python-pycairo/Config.in
```kconfig
config BR2_PACKAGE_PYTHON_PYCAIRO
	bool "python-pycairo"
	help
	  Python interface for cairo

	  https://pypi.org/project/pycairo/#description
```
